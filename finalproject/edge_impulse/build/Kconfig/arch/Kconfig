## finalproject/edge_impulse/build/Kconfig/soc/Kconfig
```kconfig
# Load Zephyr SoC Kconfig descriptions.
osource "/Users/michaelibrahim/Documents/cse/550/cse550/finalproject/edge_impulse/zephyr/soc/xlnx/zynqmp/Kconfig"
osource "/Users/michaelibrahim/Documents/cse/550/cse550/finalproject/edge_impulse/zephyr/soc/xlnx/zynq7000/Kconfig"
osource "/Users/michaelibrahim/Documents/cse/550/cse550/finalproject/edge_impulse/zephyr/soc/xlnx/versalnet/Kconfig"
osource "/Users/michaelibrahim/Documents/cse/550/cse550/finalproject/edge_impulse/zephyr/soc/xlnx/versal2/Kconfig"
osource "/Users/michaelibrahim/Documents/cse/550/cse550/finalproject/edge_impulse/zephyr/soc/xlnx/versal/Kconfig"
osource "/Users/michaelibrahim/Documents/cse/550/cse550/finalproject/edge_impulse/zephyr/soc/xen/Kconfig"
osource "/Users/michaelibrahim/Documents/cse/550/cse550/finalproject/edge_impulse/zephyr/soc/wch/ch32v/Kconfig"
osource "/Users/michaelibrahim/Documents/cse/550/cse550/finalproject/edge_impulse/zephyr/soc/ti/simplelink/Kconfig"
osource "/Users/michaelibrahim/Documents/cse/550/cse550/finalproject/edge_impulse/zephyr/soc/ti/mspm0/Kconfig"
osource "/Users/michaelibrahim/Documents/cse/550/cse550/finalproject/edge_impulse/zephyr/soc/ti/lm3s6965/Kconfig"
osource "/Users/michaelibrahim/Documents/cse/550/cse550/finalproject/edge_impulse/zephyr/soc/ti/k3/Kconfig"
osource "/Users/michaelibrahim/Documents/cse/550/cse550/finalproject/edge_impulse/zephyr/soc/telink/tlsr/Kconfig"
osource "/Users/michaelibrahim/Documents/cse/550/cse550/finalproject/edge_impulse/zephyr/soc/syna/sr100/Kconfig"
osource "/Users/michaelibrahim/Documents/cse/550/cse550/finalproject/edge_impulse/zephyr/soc/starfive/jh71xx/Kconfig"
osource "/Users/michaelibrahim/Documents/cse/550/cse550/finalproject/edge_impulse/zephyr/soc/st/stm32/Kconfig"
osource "/Users/michaelibrahim/Documents/cse/550/cse550/finalproject/edge_impulse/zephyr/soc/snps/qemu_arc/Kconfig"
osource "/Users/michaelibrahim/Documents/cse/550/cse550/finalproject/edge_impulse/zephyr/soc/snps/nsim/arc_v/Kconfig"
osource "/Users/michaelibrahim/Documents/cse/550/cse550/finalproject/edge_impulse/zephyr/soc/snps/nsim/arc_classic/Kconfig"
osource "/Users/michaelibrahim/Documents/cse/550/cse550/finalproject/edge_impulse/zephyr/soc/snps/hsdk4xd/Kconfig"
osource "/Users/michaelibrahim/Documents/cse/550/cse550/finalproject/edge_impulse/zephyr/soc/snps/hsdk/Kconfig"
osource "/Users/michaelibrahim/Documents/cse/550/cse550/finalproject/edge_impulse/zephyr/soc/snps/emsk/Kconfig"
osource "/Users/michaelibrahim/Documents/cse/550/cse550/finalproject/edge_impulse/zephyr/soc/snps/emsdp/Kconfig"
osource "/Users/michaelibrahim/Documents/cse/550/cse550/finalproject/edge_impulse/zephyr/soc/snps/arc_iot/Kconfig"
osource "/Users/michaelibrahim/Documents/cse/550/cse550/finalproject/edge_impulse/zephyr/soc/silabs/Kconfig"
osource "/Users/michaelibrahim/Documents/cse/550/cse550/finalproject/edge_impulse/zephyr/soc/sifli/sf32/Kconfig"
osource "/Users/michaelibrahim/Documents/cse/550/cse550/finalproject/edge_impulse/zephyr/soc/sifive/sifive_freedom/Kconfig"
osource "/Users/michaelibrahim/Documents/cse/550/cse550/finalproject/edge_impulse/zephyr/soc/sensry/Kconfig"
osource "/Users/michaelibrahim/Documents/cse/550/cse550/finalproject/edge_impulse/zephyr/soc/rockchip/Kconfig"
osource "/Users/michaelibrahim/Documents/cse/550/cse550/finalproject/edge_impulse/zephyr/soc/renode/riscv_virtual/Kconfig"
osource "/Users/michaelibrahim/Documents/cse/550/cse550/finalproject/edge_impulse/zephyr/soc/renode/cortex_r8_virtual/Kconfig"
osource "/Users/michaelibrahim/Documents/cse/550/cse550/finalproject/edge_impulse/zephyr/soc/renesas/smartbond/Kconfig"
osource "/Users/michaelibrahim/Documents/cse/550/cse550/finalproject/edge_impulse/zephyr/soc/renesas/rz/Kconfig"
osource "/Users/michaelibrahim/Documents/cse/550/cse550/finalproject/edge_impulse/zephyr/soc/renesas/rx/Kconfig"
osource "/Users/michaelibrahim/Documents/cse/550/cse550/finalproject/edge_impulse/zephyr/soc/renesas/rcar/Kconfig"
osource "/Users/michaelibrahim/Documents/cse/550/cse550/finalproject/edge_impulse/zephyr/soc/renesas/ra/Kconfig"
osource "/Users/michaelibrahim/Documents/cse/550/cse550/finalproject/edge_impulse/zephyr/soc/realtek/fingerprint/Kconfig"
osource "/Users/michaelibrahim/Documents/cse/550/cse550/finalproject/edge_impulse/zephyr/soc/realtek/ec/Kconfig"
osource "/Users/michaelibrahim/Documents/cse/550/cse550/finalproject/edge_impulse/zephyr/soc/realtek/bee/Kconfig"
osource "/Users/michaelibrahim/Documents/cse/550/cse550/finalproject/edge_impulse/zephyr/soc/realtek/ameba/Kconfig"
osource "/Users/michaelibrahim/Documents/cse/550/cse550/finalproject/edge_impulse/zephyr/soc/raspberrypi/rpi_pico/Kconfig"
osource "/Users/michaelibrahim/Documents/cse/550/cse550/finalproject/edge_impulse/zephyr/soc/quicklogic/eos_s3/Kconfig"
osource "/Users/michaelibrahim/Documents/cse/550/cse550/finalproject/edge_impulse/zephyr/soc/qemu/virt_riscv/Kconfig"
osource "/Users/michaelibrahim/Documents/cse/550/cse550/finalproject/edge_impulse/zephyr/soc/qemu/or1k/Kconfig"
osource "/Users/michaelibrahim/Documents/cse/550/cse550/finalproject/edge_impulse/zephyr/soc/qemu/malta/Kconfig"
osource "/Users/michaelibrahim/Documents/cse/550/cse550/finalproject/edge_impulse/zephyr/soc/openisa/rv32m1/Kconfig"
osource "/Users/michaelibrahim/Documents/cse/550/cse550/finalproject/edge_impulse/zephyr/soc/openhwgroup/cva6/Kconfig"
osource "/Users/michaelibrahim/Documents/cse/550/cse550/finalproject/edge_impulse/zephyr/soc/oct/osd32mp15x/Kconfig"
osource "/Users/michaelibrahim/Documents/cse/550/cse550/finalproject/edge_impulse/zephyr/soc/nxp/s32/Kconfig"
osource "/Users/michaelibrahim/Documents/cse/550/cse550/finalproject/edge_impulse/zephyr/soc/nxp/rw/Kconfig"
osource "/Users/michaelibrahim/Documents/cse/550/cse550/finalproject/edge_impulse/zephyr/soc/nxp/mcx/Kconfig"
osource "/Users/michaelibrahim/Documents/cse/550/cse550/finalproject/edge_impulse/zephyr/soc/nxp/lpc/Kconfig"
osource "/Users/michaelibrahim/Documents/cse/550/cse550/finalproject/edge_impulse/zephyr/soc/nxp/layerscape/Kconfig"
osource "/Users/michaelibrahim/Documents/cse/550/cse550/finalproject/edge_impulse/zephyr/soc/nxp/kinetis/Kconfig"
osource "/Users/michaelibrahim/Documents/cse/550/cse550/finalproject/edge_impulse/zephyr/soc/nxp/imxrt/Kconfig"
osource "/Users/michaelibrahim/Documents/cse/550/cse550/finalproject/edge_impulse/zephyr/soc/nxp/imx/Kconfig"
osource "/Users/michaelibrahim/Documents/cse/550/cse550/finalproject/edge_impulse/zephyr/soc/nuvoton/numicro/Kconfig"
osource "/Users/michaelibrahim/Documents/cse/550/cse550/finalproject/edge_impulse/zephyr/soc/nuvoton/numaker/Kconfig"
osource "/Users/michaelibrahim/Documents/cse/550/cse550/finalproject/edge_impulse/zephyr/soc/nuvoton/npcx/Kconfig"
osource "/Users/michaelibrahim/Documents/cse/550/cse550/finalproject/edge_impulse/zephyr/soc/nuvoton/npcm/Kconfig"
osource "/Users/michaelibrahim/Documents/cse/550/cse550/finalproject/edge_impulse/zephyr/soc/nordic/Kconfig"
osource "/Users/michaelibrahim/Documents/cse/550/cse550/finalproject/edge_impulse/zephyr/soc/neorv32/Kconfig"
osource "/Users/michaelibrahim/Documents/cse/550/cse550/finalproject/edge_impulse/zephyr/soc/native/inf_clock/Kconfig"
osource "/Users/michaelibrahim/Documents/cse/550/cse550/finalproject/edge_impulse/zephyr/soc/microchip/sam/sama7/Kconfig"
osource "/Users/michaelibrahim/Documents/cse/550/cse550/finalproject/edge_impulse/zephyr/soc/microchip/sam/sam_d5x_e5x/Kconfig"
osource "/Users/michaelibrahim/Documents/cse/550/cse550/finalproject/edge_impulse/zephyr/soc/microchip/pic64/Kconfig"
osource "/Users/michaelibrahim/Documents/cse/550/cse550/finalproject/edge_impulse/zephyr/soc/microchip/pic32c/pic32cz_ca/Kconfig"
osource "/Users/michaelibrahim/Documents/cse/550/cse550/finalproject/edge_impulse/zephyr/soc/microchip/pic32c/pic32cx_sg/Kconfig"
osource "/Users/michaelibrahim/Documents/cse/550/cse550/finalproject/edge_impulse/zephyr/soc/microchip/pic32c/pic32cm_sg_gc/Kconfig"
osource "/Users/michaelibrahim/Documents/cse/550/cse550/finalproject/edge_impulse/zephyr/soc/microchip/pic32c/pic32cm_pl/Kconfig"
osource "/Users/michaelibrahim/Documents/cse/550/cse550/finalproject/edge_impulse/zephyr/soc/microchip/pic32c/pic32cm_jh/Kconfig"
osource "/Users/michaelibrahim/Documents/cse/550/cse550/finalproject/edge_impulse/zephyr/soc/microchip/pic32c/pic32ck_sg_gc/Kconfig"
osource "/Users/michaelibrahim/Documents/cse/550/cse550/finalproject/edge_impulse/zephyr/soc/microchip/miv/Kconfig"
osource "/Users/michaelibrahim/Documents/cse/550/cse550/finalproject/edge_impulse/zephyr/soc/microchip/mec/Kconfig"
osource "/Users/michaelibrahim/Documents/cse/550/cse550/finalproject/edge_impulse/zephyr/soc/mediatek/mt8xxx/Kconfig"
osource "/Users/michaelibrahim/Documents/cse/550/cse550/finalproject/edge_impulse/zephyr/soc/lowrisc/opentitan/Kconfig"
osource "/Users/michaelibrahim/Documents/cse/550/cse550/finalproject/edge_impulse/zephyr/soc/litex/Kconfig"
osource "/Users/michaelibrahim/Documents/cse/550/cse550/finalproject/edge_impulse/zephyr/soc/ite/ec/Kconfig"
osource "/Users/michaelibrahim/Documents/cse/550/cse550/finalproject/edge_impulse/zephyr/soc/intel/wildcat_lake/Kconfig"
osource "/Users/michaelibrahim/Documents/cse/550/cse550/finalproject/edge_impulse/zephyr/soc/intel/raptor_lake/Kconfig"
osource "/Users/michaelibrahim/Documents/cse/550/cse550/finalproject/edge_impulse/zephyr/soc/intel/panther_lake/Kconfig"
osource "/Users/michaelibrahim/Documents/cse/550/cse550/finalproject/edge_impulse/zephyr/soc/intel/lakemont/Kconfig"
osource "/Users/michaelibrahim/Documents/cse/550/cse550/finalproject/edge_impulse/zephyr/soc/intel/intel_socfpga_std/Kconfig"
osource "/Users/michaelibrahim/Documents/cse/550/cse550/finalproject/edge_impulse/zephyr/soc/intel/intel_socfpga/Kconfig"
osource "/Users/michaelibrahim/Documents/cse/550/cse550/finalproject/edge_impulse/zephyr/soc/intel/intel_niosv/Kconfig"
osource "/Users/michaelibrahim/Documents/cse/550/cse550/finalproject/edge_impulse/zephyr/soc/intel/intel_ish/Kconfig"
osource "/Users/michaelibrahim/Documents/cse/550/cse550/finalproject/edge_impulse/zephyr/soc/intel/intel_adsp/Kconfig"
osource "/Users/michaelibrahim/Documents/cse/550/cse550/finalproject/edge_impulse/zephyr/soc/intel/elkhart_lake/Kconfig"
osource "/Users/michaelibrahim/Documents/cse/550/cse550/finalproject/edge_impulse/zephyr/soc/intel/atom/Kconfig"
osource "/Users/michaelibrahim/Documents/cse/550/cse550/finalproject/edge_impulse/zephyr/soc/intel/apollo_lake/Kconfig"
osource "/Users/michaelibrahim/Documents/cse/550/cse550/finalproject/edge_impulse/zephyr/soc/intel/alder_lake/Kconfig"
osource "/Users/michaelibrahim/Documents/cse/550/cse550/finalproject/edge_impulse/zephyr/soc/infineon/psoc4/Kconfig"
osource "/Users/michaelibrahim/Documents/cse/550/cse550/finalproject/edge_impulse/zephyr/soc/infineon/edge/Kconfig"
osource "/Users/michaelibrahim/Documents/cse/550/cse550/finalproject/edge_impulse/zephyr/soc/infineon/cat3/Kconfig"
osource "/Users/michaelibrahim/Documents/cse/550/cse550/finalproject/edge_impulse/zephyr/soc/infineon/cat1c/Kconfig"
osource "/Users/michaelibrahim/Documents/cse/550/cse550/finalproject/edge_impulse/zephyr/soc/infineon/cat1b/Kconfig"
osource "/Users/michaelibrahim/Documents/cse/550/cse550/finalproject/edge_impulse/zephyr/soc/infineon/cat1a/Kconfig"
osource "/Users/michaelibrahim/Documents/cse/550/cse550/finalproject/edge_impulse/zephyr/soc/gd/gd32/Kconfig"
osource "/Users/michaelibrahim/Documents/cse/550/cse550/finalproject/edge_impulse/zephyr/soc/gaisler/leon3/Kconfig"
osource "/Users/michaelibrahim/Documents/cse/550/cse550/finalproject/edge_impulse/zephyr/soc/gaisler/gr716a/Kconfig"
osource "/Users/michaelibrahim/Documents/cse/550/cse550/finalproject/edge_impulse/zephyr/soc/focaltech/Kconfig"
osource "/Users/michaelibrahim/Documents/cse/550/cse550/finalproject/edge_impulse/zephyr/soc/espressif/Kconfig"
osource "/Users/michaelibrahim/Documents/cse/550/cse550/finalproject/edge_impulse/zephyr/soc/ene/kb1200/Kconfig"
osource "/Users/michaelibrahim/Documents/cse/550/cse550/finalproject/edge_impulse/zephyr/soc/ene/kb106x/Kconfig"
osource "/Users/michaelibrahim/Documents/cse/550/cse550/finalproject/edge_impulse/zephyr/soc/elan/em32f967/Kconfig"
osource "/Users/michaelibrahim/Documents/cse/550/cse550/finalproject/edge_impulse/zephyr/soc/egis/Kconfig"
osource "/Users/michaelibrahim/Documents/cse/550/cse550/finalproject/edge_impulse/zephyr/soc/efinix/sapphire/Kconfig"
osource "/Users/michaelibrahim/Documents/cse/550/cse550/finalproject/edge_impulse/zephyr/soc/cdns/xtensa_sample_controller/Kconfig"
osource "/Users/michaelibrahim/Documents/cse/550/cse550/finalproject/edge_impulse/zephyr/soc/cdns/swerv/Kconfig"
osource "/Users/michaelibrahim/Documents/cse/550/cse550/finalproject/edge_impulse/zephyr/soc/cdns/sample_controller32/Kconfig"
osource "/Users/michaelibrahim/Documents/cse/550/cse550/finalproject/edge_impulse/zephyr/soc/cdns/dc233c/Kconfig"
osource "/Users/michaelibrahim/Documents/cse/550/cse550/finalproject/edge_impulse/zephyr/soc/brcm/bcmvk/Kconfig"
osource "/Users/michaelibrahim/Documents/cse/550/cse550/finalproject/edge_impulse/zephyr/soc/brcm/bcm2712/Kconfig"
osource "/Users/michaelibrahim/Documents/cse/550/cse550/finalproject/edge_impulse/zephyr/soc/brcm/bcm2711/Kconfig"
osource "/Users/michaelibrahim/Documents/cse/550/cse550/finalproject/edge_impulse/zephyr/soc/blackberry/qnxhv_vm/Kconfig"
osource "/Users/michaelibrahim/Documents/cse/550/cse550/finalproject/edge_impulse/zephyr/soc/bflb/Kconfig"
osource "/Users/michaelibrahim/Documents/cse/550/cse550/finalproject/edge_impulse/zephyr/soc/atmel/sam0/Kconfig"
osource "/Users/michaelibrahim/Documents/cse/550/cse550/finalproject/edge_impulse/zephyr/soc/atmel/sam/Kconfig"
osource "/Users/michaelibrahim/Documents/cse/550/cse550/finalproject/edge_impulse/zephyr/soc/aspeed/Kconfig"
osource "/Users/michaelibrahim/Documents/cse/550/cse550/finalproject/edge_impulse/zephyr/soc/arm/Kconfig"
osource "/Users/michaelibrahim/Documents/cse/550/cse550/finalproject/edge_impulse/zephyr/soc/arm/beetle/Kconfig"
osource "/Users/michaelibrahim/Documents/cse/550/cse550/finalproject/edge_impulse/zephyr/soc/antmicro/myra/Kconfig"
osource "/Users/michaelibrahim/Documents/cse/550/cse550/finalproject/edge_impulse/zephyr/soc/andestech/Kconfig"
osource "/Users/michaelibrahim/Documents/cse/550/cse550/finalproject/edge_impulse/zephyr/soc/amd/acp_7_x/Kconfig"
osource "/Users/michaelibrahim/Documents/cse/550/cse550/finalproject/edge_impulse/zephyr/soc/amd/acp_7_0/Kconfig"
osource "/Users/michaelibrahim/Documents/cse/550/cse550/finalproject/edge_impulse/zephyr/soc/amd/acp_6_0/Kconfig"
osource "/Users/michaelibrahim/Documents/cse/550/cse550/finalproject/edge_impulse/zephyr/soc/ambiq/Kconfig"
osource "/Users/michaelibrahim/Documents/cse/550/cse550/finalproject/edge_impulse/zephyr/soc/allwinner/sun8i_h3/Kconfig"
osource "/Users/michaelibrahim/Documents/cse/550/cse550/finalproject/edge_impulse/zephyr/soc/allwinner/sun50i_h618/Kconfig"
osource "/Users/michaelibrahim/Documents/cse/550/cse550/finalproject/edge_impulse/zephyr/soc/alif/ensemble/Kconfig"
osource "/Users/michaelibrahim/Documents/cse/550/cse550/finalproject/edge_impulse/zephyr/soc/alif/balletto/Kconfig"
osource "/Users/michaelibrahim/Documents/cse/550/cse550/finalproject/edge_impulse/zephyr/soc/aesc/Kconfig"
osource "/Users/michaelibrahim/Documents/cse/550/cse550/finalproject/edge_impulse/zephyr/soc/adi/max32/Kconfig"
```
