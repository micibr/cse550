## finalproject/edge_impulse/build/ipc_radio/Kconfig/boards/Kconfig.defconfig
```kconfig
# Load Zephyr board defconfig descriptions.
osource "/opt/nordic/ncs/v3.0.2/zephyr/boards/nordic/nrf5340dk/Kconfig.defconfig"
```

## finalproject/edge_impulse/build/machine_learning/Kconfig/boards/Kconfig.nrf5340dk
```kconfig
# Load board Kconfig descriptions.
osource "/opt/nordic/ncs/v3.0.2/zephyr/boards/nordic/nrf5340dk/Kconfig.nrf5340dk"
```

## finalproject/edge_impulse/build/mcuboot/Kconfig/boards/Kconfig.sysbuild
```kconfig
# Load Sysbuild board Kconfig descriptions.
osource "/opt/nordic/ncs/v3.0.2/zephyr/boards/nordic/nrf5340dk/Kconfig.sysbuild"
```
