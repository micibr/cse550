## finalproject/edge_impulse/build/Kconfig/soc/Kconfig.defconfig
```kconfig
# Load Zephyr SoC defconfig descriptions.
osource "/Users/michaelibrahim/Documents/cse/550/cse550/finalproject/edge_impulse/zephyr/soc/xlnx/zynqmp/Kconfig.defconfig"
osource "/Users/michaelibrahim/Documents/cse/550/cse550/finalproject/edge_impulse/zephyr/soc/xlnx/zynq7000/Kconfig.defconfig"
osource "/Users/michaelibrahim/Documents/cse/550/cse550/finalproject/edge_impulse/zephyr/soc/xlnx/versalnet/Kconfig.defconfig"
osource "/Users/michaelibrahim/Documents/cse/550/cse550/finalproject/edge_impulse/zephyr/soc/xlnx/versal2/Kconfig.defconfig"
osource "/Users/michaelibrahim/Documents/cse/550/cse550/finalproject/edge_impulse/zephyr/soc/xlnx/versal/Kconfig.defconfig"
osource "/Users/michaelibrahim/Documents/cse/550/cse550/finalproject/edge_impulse/zephyr/soc/xen/Kconfig.defconfig"
osource "/Users/michaelibrahim/Documents/cse/550/cse550/finalproject/edge_impulse/zephyr/soc/wch/ch32v/Kconfig.defconfig"
osource "/Users/michaelibrahim/Documents/cse/550/cse550/finalproject/edge_impulse/zephyr/soc/ti/simplelink/Kconfig.defconfig"
osource "/Users/michaelibrahim/Documents/cse/550/cse550/finalproject/edge_impulse/zephyr/soc/ti/mspm0/Kconfig.defconfig"
osource "/Users/michaelibrahim/Documents/cse/550/cse550/finalproject/edge_impulse/zephyr/soc/ti/lm3s6965/Kconfig.defconfig"
osource "/Users/michaelibrahim/Documents/cse/550/cse550/finalproject/edge_impulse/zephyr/soc/ti/k3/Kconfig.defconfig"
osource "/Users/michaelibrahim/Documents/cse/550/cse550/finalproject/edge_impulse/zephyr/soc/telink/tlsr/Kconfig.defconfig"
osource "/Users/michaelibrahim/Documents/cse/550/cse550/finalproject/edge_impulse/zephyr/soc/syna/sr100/Kconfig.defconfig"
osource "/Users/michaelibrahim/Documents/cse/550/cse550/finalproject/edge_impulse/zephyr/soc/starfive/jh71xx/Kconfig.defconfig"
osource "/Users/michaelibrahim/Documents/cse/550/cse550/finalproject/edge_impulse/zephyr/soc/st/stm32/Kconfig.defconfig"
osource "/Users/michaelibrahim/Documents/cse/550/cse550/finalproject/edge_impulse/zephyr/soc/snps/qemu_arc/Kconfig.defconfig"
osource "/Users/michaelibrahim/Documents/cse/550/cse550/finalproject/edge_impulse/zephyr/soc/snps/nsim/arc_v/Kconfig.defconfig"
osource "/Users/michaelibrahim/Documents/cse/550/cse550/finalproject/edge_impulse/zephyr/soc/snps/nsim/arc_classic/Kconfig.defconfig"
osource "/Users/michaelibrahim/Documents/cse/550/cse550/finalproject/edge_impulse/zephyr/soc/snps/hsdk4xd/Kconfig.defconfig"
osource "/Users/michaelibrahim/Documents/cse/550/cse550/finalproject/edge_impulse/zephyr/soc/snps/hsdk/Kconfig.defconfig"
osource "/Users/michaelibrahim/Documents/cse/550/cse550/finalproject/edge_impulse/zephyr/soc/snps/emsk/Kconfig.defconfig"
osource "/Users/michaelibrahim/Documents/cse/550/cse550/finalproject/edge_impulse/zephyr/soc/snps/emsdp/Kconfig.defconfig"
osource "/Users/michaelibrahim/Documents/cse/550/cse550/finalproject/edge_impulse/zephyr/soc/snps/arc_iot/Kconfig.defconfig"
osource "/Users/michaelibrahim/Documents/cse/550/cse550/finalproject/edge_impulse/zephyr/soc/silabs/Kconfig.defconfig"
osource "/Users/michaelibrahim/Documents/cse/550/cse550/finalproject/edge_impulse/zephyr/soc/sifli/sf32/Kconfig.defconfig"
osource "/Users/michaelibrahim/Documents/cse/550/cse550/finalproject/edge_impulse/zephyr/soc/sifive/sifive_freedom/Kconfig.defconfig"
osource "/Users/michaelibrahim/Documents/cse/550/cse550/finalproject/edge_impulse/zephyr/soc/sensry/Kconfig.defconfig"
osource "/Users/michaelibrahim/Documents/cse/550/cse550/finalproject/edge_impulse/zephyr/soc/rockchip/Kconfig.defconfig"
osource "/Users/michaelibrahim/Documents/cse/550/cse550/finalproject/edge_impulse/zephyr/soc/renode/riscv_virtual/Kconfig.defconfig"
osource "/Users/michaelibrahim/Documents/cse/550/cse550/finalproject/edge_impulse/zephyr/soc/renode/cortex_r8_virtual/Kconfig.defconfig"
osource "/Users/michaelibrahim/Documents/cse/550/cse550/finalproject/edge_impulse/zephyr/soc/renesas/smartbond/Kconfig.defconfig"
osource "/Users/michaelibrahim/Documents/cse/550/cse550/finalproject/edge_impulse/zephyr/soc/renesas/rz/Kconfig.defconfig"
osource "/Users/michaelibrahim/Documents/cse/550/cse550/finalproject/edge_impulse/zephyr/soc/renesas/rx/Kconfig.defconfig"
osource "/Users/michaelibrahim/Documents/cse/550/cse550/finalproject/edge_impulse/zephyr/soc/renesas/rcar/Kconfig.defconfig"
osource "/Users/michaelibrahim/Documents/cse/550/cse550/finalproject/edge_impulse/zephyr/soc/renesas/ra/Kconfig.defconfig"
osource "/Users/michaelibrahim/Documents/cse/550/cse550/finalproject/edge_impulse/zephyr/soc/realtek/fingerprint/Kconfig.defconfig"
osource "/Users/michaelibrahim/Documents/cse/550/cse550/finalproject/edge_impulse/zephyr/soc/realtek/ec/Kconfig.defconfig"
osource "/Users/michaelibrahim/Documents/cse/550/cse550/finalproject/edge_impulse/zephyr/soc/realtek/bee/Kconfig.defconfig"
osource "/Users/michaelibrahim/Documents/cse/550/cse550/finalproject/edge_impulse/zephyr/soc/realtek/ameba/Kconfig.defconfig"
osource "/Users/michaelibrahim/Documents/cse/550/cse550/finalproject/edge_impulse/zephyr/soc/raspberrypi/rpi_pico/Kconfig.defconfig"
osource "/Users/michaelibrahim/Documents/cse/550/cse550/finalproject/edge_impulse/zephyr/soc/quicklogic/eos_s3/Kconfig.defconfig"
osource "/Users/michaelibrahim/Documents/cse/550/cse550/finalproject/edge_impulse/zephyr/soc/qemu/virt_riscv/Kconfig.defconfig"
osource "/Users/michaelibrahim/Documents/cse/550/cse550/finalproject/edge_impulse/zephyr/soc/qemu/or1k/Kconfig.defconfig"
osource "/Users/michaelibrahim/Documents/cse/550/cse550/finalproject/edge_impulse/zephyr/soc/qemu/malta/Kconfig.defconfig"
osource "/Users/michaelibrahim/Documents/cse/550/cse550/finalproject/edge_impulse/zephyr/soc/openisa/rv32m1/Kconfig.defconfig"
osource "/Users/michaelibrahim/Documents/cse/550/cse550/finalproject/edge_impulse/zephyr/soc/openhwgroup/cva6/Kconfig.defconfig"
osource "/Users/michaelibrahim/Documents/cse/550/cse550/finalproject/edge_impulse/zephyr/soc/oct/osd32mp15x/Kconfig.defconfig"
osource "/Users/michaelibrahim/Documents/cse/550/cse550/finalproject/edge_impulse/zephyr/soc/nxp/s32/Kconfig.defconfig"
osource "/Users/michaelibrahim/Documents/cse/550/cse550/finalproject/edge_impulse/zephyr/soc/nxp/rw/Kconfig.defconfig"
osource "/Users/michaelibrahim/Documents/cse/550/cse550/finalproject/edge_impulse/zephyr/soc/nxp/mcx/Kconfig.defconfig"
osource "/Users/michaelibrahim/Documents/cse/550/cse550/finalproject/edge_impulse/zephyr/soc/nxp/lpc/Kconfig.defconfig"
osource "/Users/michaelibrahim/Documents/cse/550/cse550/finalproject/edge_impulse/zephyr/soc/nxp/layerscape/Kconfig.defconfig"
osource "/Users/michaelibrahim/Documents/cse/550/cse550/finalproject/edge_impulse/zephyr/soc/nxp/kinetis/Kconfig.defconfig"
osource "/Users/michaelibrahim/Documents/cse/550/cse550/finalproject/edge_impulse/zephyr/soc/nxp/imxrt/Kconfig.defconfig"
osource "/Users/michaelibrahim/Documents/cse/550/cse550/finalproject/edge_impulse/zephyr/soc/nxp/imx/Kconfig.defconfig"
osource "/Users/michaelibrahim/Documents/cse/550/cse550/finalproject/edge_impulse/zephyr/soc/nuvoton/numicro/Kconfig.defconfig"
osource "/Users/michaelibrahim/Documents/cse/550/cse550/finalproject/edge_impulse/zephyr/soc/nuvoton/numaker/Kconfig.defconfig"
osource "/Users/michaelibrahim/Documents/cse/550/cse550/finalproject/edge_impulse/zephyr/soc/nuvoton/npcx/Kconfig.defconfig"
osource "/Users/michaelibrahim/Documents/cse/550/cse550/finalproject/edge_impulse/zephyr/soc/nuvoton/npcm/Kconfig.defconfig"
osource "/Users/michaelibrahim/Documents/cse/550/cse550/finalproject/edge_impulse/zephyr/soc/nordic/Kconfig.defconfig"
osource "/Users/michaelibrahim/Documents/cse/550/cse550/finalproject/edge_impulse/zephyr/soc/neorv32/Kconfig.defconfig"
osource "/Users/michaelibrahim/Documents/cse/550/cse550/finalproject/edge_impulse/zephyr/soc/native/inf_clock/Kconfig.defconfig"
osource "/Users/michaelibrahim/Documents/cse/550/cse550/finalproject/edge_impulse/zephyr/soc/microchip/sam/sama7/Kconfig.defconfig"
osource "/Users/michaelibrahim/Documents/cse/550/cse550/finalproject/edge_impulse/zephyr/soc/microchip/sam/sam_d5x_e5x/Kconfig.defconfig"
osource "/Users/michaelibrahim/Documents/cse/550/cse550/finalproject/edge_impulse/zephyr/soc/microchip/pic64/Kconfig.defconfig"
osource "/Users/michaelibrahim/Documents/cse/550/cse550/finalproject/edge_impulse/zephyr/soc/microchip/pic32c/pic32cz_ca/Kconfig.defconfig"
osource "/Users/michaelibrahim/Documents/cse/550/cse550/finalproject/edge_impulse/zephyr/soc/microchip/pic32c/pic32cx_sg/Kconfig.defconfig"
osource "/Users/michaelibrahim/Documents/cse/550/cse550/finalproject/edge_impulse/zephyr/soc/microchip/pic32c/pic32cm_sg_gc/Kconfig.defconfig"
osource "/Users/michaelibrahim/Documents/cse/550/cse550/finalproject/edge_impulse/zephyr/soc/microchip/pic32c/pic32cm_pl/Kconfig.defconfig"
osource "/Users/michaelibrahim/Documents/cse/550/cse550/finalproject/edge_impulse/zephyr/soc/microchip/pic32c/pic32cm_jh/Kconfig.defconfig"
osource "/Users/michaelibrahim/Documents/cse/550/cse550/finalproject/edge_impulse/zephyr/soc/microchip/pic32c/pic32ck_sg_gc/Kconfig.defconfig"
osource "/Users/michaelibrahim/Documents/cse/550/cse550/finalproject/edge_impulse/zephyr/soc/microchip/miv/Kconfig.defconfig"
osource "/Users/michaelibrahim/Documents/cse/550/cse550/finalproject/edge_impulse/zephyr/soc/microchip/mec/Kconfig.defconfig"
osource "/Users/michaelibrahim/Documents/cse/550/cse550/finalproject/edge_impulse/zephyr/soc/mediatek/mt8xxx/Kconfig.defconfig"
osource "/Users/michaelibrahim/Documents/cse/550/cse550/finalproject/edge_impulse/zephyr/soc/lowrisc/opentitan/Kconfig.defconfig"
osource "/Users/michaelibrahim/Documents/cse/550/cse550/finalproject/edge_impulse/zephyr/soc/litex/Kconfig.defconfig"
osource "/Users/michaelibrahim/Documents/cse/550/cse550/finalproject/edge_impulse/zephyr/soc/ite/ec/Kconfig.defconfig"
osource "/Users/michaelibrahim/Documents/cse/550/cse550/finalproject/edge_impulse/zephyr/soc/intel/wildcat_lake/Kconfig.defconfig"
osource "/Users/michaelibrahim/Documents/cse/550/cse550/finalproject/edge_impulse/zephyr/soc/intel/raptor_lake/Kconfig.defconfig"
osource "/Users/michaelibrahim/Documents/cse/550/cse550/finalproject/edge_impulse/zephyr/soc/intel/panther_lake/Kconfig.defconfig"
osource "/Users/michaelibrahim/Documents/cse/550/cse550/finalproject/edge_impulse/zephyr/soc/intel/lakemont/Kconfig.defconfig"
osource "/Users/michaelibrahim/Documents/cse/550/cse550/finalproject/edge_impulse/zephyr/soc/intel/intel_socfpga_std/Kconfig.defconfig"
osource "/Users/michaelibrahim/Documents/cse/550/cse550/finalproject/edge_impulse/zephyr/soc/intel/intel_socfpga/Kconfig.defconfig"
osource "/Users/michaelibrahim/Documents/cse/550/cse550/finalproject/edge_impulse/zephyr/soc/intel/intel_niosv/Kconfig.defconfig"
osource "/Users/michaelibrahim/Documents/cse/550/cse550/finalproject/edge_impulse/zephyr/soc/intel/intel_ish/Kconfig.defconfig"
osource "/Users/michaelibrahim/Documents/cse/550/cse550/finalproject/edge_impulse/zephyr/soc/intel/intel_adsp/Kconfig.defconfig"
osource "/Users/michaelibrahim/Documents/cse/550/cse550/finalproject/edge_impulse/zephyr/soc/intel/elkhart_lake/Kconfig.defconfig"
osource "/Users/michaelibrahim/Documents/cse/550/cse550/finalproject/edge_impulse/zephyr/soc/intel/atom/Kconfig.defconfig"
osource "/Users/michaelibrahim/Documents/cse/550/cse550/finalproject/edge_impulse/zephyr/soc/intel/apollo_lake/Kconfig.defconfig"
osource "/Users/michaelibrahim/Documents/cse/550/cse550/finalproject/edge_impulse/zephyr/soc/intel/alder_lake/Kconfig.defconfig"
osource "/Users/michaelibrahim/Documents/cse/550/cse550/finalproject/edge_impulse/zephyr/soc/infineon/psoc4/Kconfig.defconfig"
osource "/Users/michaelibrahim/Documents/cse/550/cse550/finalproject/edge_impulse/zephyr/soc/infineon/edge/Kconfig.defconfig"
osource "/Users/michaelibrahim/Documents/cse/550/cse550/finalproject/edge_impulse/zephyr/soc/infineon/cat3/Kconfig.defconfig"
osource "/Users/michaelibrahim/Documents/cse/550/cse550/finalproject/edge_impulse/zephyr/soc/infineon/cat1c/Kconfig.defconfig"
osource "/Users/michaelibrahim/Documents/cse/550/cse550/finalproject/edge_impulse/zephyr/soc/infineon/cat1b/Kconfig.defconfig"
osource "/Users/michaelibrahim/Documents/cse/550/cse550/finalproject/edge_impulse/zephyr/soc/infineon/cat1a/Kconfig.defconfig"
osource "/Users/michaelibrahim/Documents/cse/550/cse550/finalproject/edge_impulse/zephyr/soc/gd/gd32/Kconfig.defconfig"
osource "/Users/michaelibrahim/Documents/cse/550/cse550/finalproject/edge_impulse/zephyr/soc/gaisler/leon3/Kconfig.defconfig"
osource "/Users/michaelibrahim/Documents/cse/550/cse550/finalproject/edge_impulse/zephyr/soc/gaisler/gr716a/Kconfig.defconfig"
osource "/Users/michaelibrahim/Documents/cse/550/cse550/finalproject/edge_impulse/zephyr/soc/focaltech/Kconfig.defconfig"
osource "/Users/michaelibrahim/Documents/cse/550/cse550/finalproject/edge_impulse/zephyr/soc/espressif/Kconfig.defconfig"
osource "/Users/michaelibrahim/Documents/cse/550/cse550/finalproject/edge_impulse/zephyr/soc/ene/kb1200/Kconfig.defconfig"
osource "/Users/michaelibrahim/Documents/cse/550/cse550/finalproject/edge_impulse/zephyr/soc/ene/kb106x/Kconfig.defconfig"
osource "/Users/michaelibrahim/Documents/cse/550/cse550/finalproject/edge_impulse/zephyr/soc/elan/em32f967/Kconfig.defconfig"
osource "/Users/michaelibrahim/Documents/cse/550/cse550/finalproject/edge_impulse/zephyr/soc/egis/Kconfig.defconfig"
osource "/Users/michaelibrahim/Documents/cse/550/cse550/finalproject/edge_impulse/zephyr/soc/efinix/sapphire/Kconfig.defconfig"
osource "/Users/michaelibrahim/Documents/cse/550/cse550/finalproject/edge_impulse/zephyr/soc/cdns/xtensa_sample_controller/Kconfig.defconfig"
osource "/Users/michaelibrahim/Documents/cse/550/cse550/finalproject/edge_impulse/zephyr/soc/cdns/swerv/Kconfig.defconfig"
osource "/Users/michaelibrahim/Documents/cse/550/cse550/finalproject/edge_impulse/zephyr/soc/cdns/sample_controller32/Kconfig.defconfig"
osource "/Users/michaelibrahim/Documents/cse/550/cse550/finalproject/edge_impulse/zephyr/soc/cdns/dc233c/Kconfig.defconfig"
osource "/Users/michaelibrahim/Documents/cse/550/cse550/finalproject/edge_impulse/zephyr/soc/brcm/bcmvk/Kconfig.defconfig"
osource "/Users/michaelibrahim/Documents/cse/550/cse550/finalproject/edge_impulse/zephyr/soc/brcm/bcm2712/Kconfig.defconfig"
osource "/Users/michaelibrahim/Documents/cse/550/cse550/finalproject/edge_impulse/zephyr/soc/brcm/bcm2711/Kconfig.defconfig"
osource "/Users/michaelibrahim/Documents/cse/550/cse550/finalproject/edge_impulse/zephyr/soc/blackberry/qnxhv_vm/Kconfig.defconfig"
osource "/Users/michaelibrahim/Documents/cse/550/cse550/finalproject/edge_impulse/zephyr/soc/bflb/Kconfig.defconfig"
osource "/Users/michaelibrahim/Documents/cse/550/cse550/finalproject/edge_impulse/zephyr/soc/atmel/sam0/Kconfig.defconfig"
osource "/Users/michaelibrahim/Documents/cse/550/cse550/finalproject/edge_impulse/zephyr/soc/atmel/sam/Kconfig.defconfig"
osource "/Users/michaelibrahim/Documents/cse/550/cse550/finalproject/edge_impulse/zephyr/soc/aspeed/Kconfig.defconfig"
osource "/Users/michaelibrahim/Documents/cse/550/cse550/finalproject/edge_impulse/zephyr/soc/arm/Kconfig.defconfig"
osource "/Users/michaelibrahim/Documents/cse/550/cse550/finalproject/edge_impulse/zephyr/soc/arm/beetle/Kconfig.defconfig"
osource "/Users/michaelibrahim/Documents/cse/550/cse550/finalproject/edge_impulse/zephyr/soc/antmicro/myra/Kconfig.defconfig"
osource "/Users/michaelibrahim/Documents/cse/550/cse550/finalproject/edge_impulse/zephyr/soc/andestech/Kconfig.defconfig"
osource "/Users/michaelibrahim/Documents/cse/550/cse550/finalproject/edge_impulse/zephyr/soc/amd/acp_7_x/Kconfig.defconfig"
osource "/Users/michaelibrahim/Documents/cse/550/cse550/finalproject/edge_impulse/zephyr/soc/amd/acp_7_0/Kconfig.defconfig"
osource "/Users/michaelibrahim/Documents/cse/550/cse550/finalproject/edge_impulse/zephyr/soc/amd/acp_6_0/Kconfig.defconfig"
osource "/Users/michaelibrahim/Documents/cse/550/cse550/finalproject/edge_impulse/zephyr/soc/ambiq/Kconfig.defconfig"
osource "/Users/michaelibrahim/Documents/cse/550/cse550/finalproject/edge_impulse/zephyr/soc/allwinner/sun8i_h3/Kconfig.defconfig"
osource "/Users/michaelibrahim/Documents/cse/550/cse550/finalproject/edge_impulse/zephyr/soc/allwinner/sun50i_h618/Kconfig.defconfig"
osource "/Users/michaelibrahim/Documents/cse/550/cse550/finalproject/edge_impulse/zephyr/soc/alif/ensemble/Kconfig.defconfig"
osource "/Users/michaelibrahim/Documents/cse/550/cse550/finalproject/edge_impulse/zephyr/soc/alif/balletto/Kconfig.defconfig"
osource "/Users/michaelibrahim/Documents/cse/550/cse550/finalproject/edge_impulse/zephyr/soc/aesc/Kconfig.defconfig"
osource "/Users/michaelibrahim/Documents/cse/550/cse550/finalproject/edge_impulse/zephyr/soc/adi/max32/Kconfig.defconfig"
```
