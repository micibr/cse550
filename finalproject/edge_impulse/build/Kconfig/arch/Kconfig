## finalproject/edge_impulse/build/Kconfig/soc/Kconfig.soc
```kconfig
# Load SoC Kconfig descriptions.
osource "/Users/michaelibrahim/Documents/cse/550/cse550/finalproject/edge_impulse/zephyr/soc/xlnx/zynqmp/Kconfig.soc"
osource "/Users/michaelibrahim/Documents/cse/550/cse550/finalproject/edge_impulse/zephyr/soc/xlnx/zynq7000/Kconfig.soc"
osource "/Users/michaelibrahim/Documents/cse/550/cse550/finalproject/edge_impulse/zephyr/soc/xlnx/versalnet/Kconfig.soc"
osource "/Users/michaelibrahim/Documents/cse/550/cse550/finalproject/edge_impulse/zephyr/soc/xlnx/versal2/Kconfig.soc"
osource "/Users/michaelibrahim/Documents/cse/550/cse550/finalproject/edge_impulse/zephyr/soc/xlnx/versal/Kconfig.soc"
osource "/Users/michaelibrahim/Documents/cse/550/cse550/finalproject/edge_impulse/zephyr/soc/xen/Kconfig.soc"
osource "/Users/michaelibrahim/Documents/cse/550/cse550/finalproject/edge_impulse/zephyr/soc/wch/ch32v/Kconfig.soc"
osource "/Users/michaelibrahim/Documents/cse/550/cse550/finalproject/edge_impulse/zephyr/soc/ti/simplelink/Kconfig.soc"
osource "/Users/michaelibrahim/Documents/cse/550/cse550/finalproject/edge_impulse/zephyr/soc/ti/mspm0/Kconfig.soc"
osource "/Users/michaelibrahim/Documents/cse/550/cse550/finalproject/edge_impulse/zephyr/soc/ti/lm3s6965/Kconfig.soc"
osource "/Users/michaelibrahim/Documents/cse/550/cse550/finalproject/edge_impulse/zephyr/soc/ti/k3/Kconfig.soc"
osource "/Users/michaelibrahim/Documents/cse/550/cse550/finalproject/edge_impulse/zephyr/soc/telink/tlsr/Kconfig.soc"
osource "/Users/michaelibrahim/Documents/cse/550/cse550/finalproject/edge_impulse/zephyr/soc/syna/sr100/Kconfig.soc"
osource "/Users/michaelibrahim/Documents/cse/550/cse550/finalproject/edge_impulse/zephyr/soc/starfive/jh71xx/Kconfig.soc"
osource "/Users/michaelibrahim/Documents/cse/550/cse550/finalproject/edge_impulse/zephyr/soc/st/stm32/Kconfig.soc"
osource "/Users/michaelibrahim/Documents/cse/550/cse550/finalproject/edge_impulse/zephyr/soc/snps/qemu_arc/Kconfig.soc"
osource "/Users/michaelibrahim/Documents/cse/550/cse550/finalproject/edge_impulse/zephyr/soc/snps/nsim/arc_v/Kconfig.soc"
osource "/Users/michaelibrahim/Documents/cse/550/cse550/finalproject/edge_impulse/zephyr/soc/snps/nsim/arc_classic/Kconfig.soc"
osource "/Users/michaelibrahim/Documents/cse/550/cse550/finalproject/edge_impulse/zephyr/soc/snps/hsdk4xd/Kconfig.soc"
osource "/Users/michaelibrahim/Documents/cse/550/cse550/finalproject/edge_impulse/zephyr/soc/snps/hsdk/Kconfig.soc"
osource "/Users/michaelibrahim/Documents/cse/550/cse550/finalproject/edge_impulse/zephyr/soc/snps/emsk/Kconfig.soc"
osource "/Users/michaelibrahim/Documents/cse/550/cse550/finalproject/edge_impulse/zephyr/soc/snps/emsdp/Kconfig.soc"
osource "/Users/michaelibrahim/Documents/cse/550/cse550/finalproject/edge_impulse/zephyr/soc/snps/arc_iot/Kconfig.soc"
osource "/Users/michaelibrahim/Documents/cse/550/cse550/finalproject/edge_impulse/zephyr/soc/silabs/Kconfig.soc"
osource "/Users/michaelibrahim/Documents/cse/550/cse550/finalproject/edge_impulse/zephyr/soc/sifli/sf32/Kconfig.soc"
osource "/Users/michaelibrahim/Documents/cse/550/cse550/finalproject/edge_impulse/zephyr/soc/sifive/sifive_freedom/Kconfig.soc"
osource "/Users/michaelibrahim/Documents/cse/550/cse550/finalproject/edge_impulse/zephyr/soc/sensry/Kconfig.soc"
osource "/Users/michaelibrahim/Documents/cse/550/cse550/finalproject/edge_impulse/zephyr/soc/rockchip/Kconfig.soc"
osource "/Users/michaelibrahim/Documents/cse/550/cse550/finalproject/edge_impulse/zephyr/soc/renode/riscv_virtual/Kconfig.soc"
osource "/Users/michaelibrahim/Documents/cse/550/cse550/finalproject/edge_impulse/zephyr/soc/renode/cortex_r8_virtual/Kconfig.soc"
osource "/Users/michaelibrahim/Documents/cse/550/cse550/finalproject/edge_impulse/zephyr/soc/renesas/smartbond/Kconfig.soc"
osource "/Users/michaelibrahim/Documents/cse/550/cse550/finalproject/edge_impulse/zephyr/soc/renesas/rz/Kconfig.soc"
osource "/Users/michaelibrahim/Documents/cse/550/cse550/finalproject/edge_impulse/zephyr/soc/renesas/rx/Kconfig.soc"
osource "/Users/michaelibrahim/Documents/cse/550/cse550/finalproject/edge_impulse/zephyr/soc/renesas/rcar/Kconfig.soc"
osource "/Users/michaelibrahim/Documents/cse/550/cse550/finalproject/edge_impulse/zephyr/soc/renesas/ra/Kconfig.soc"
osource "/Users/michaelibrahim/Documents/cse/550/cse550/finalproject/edge_impulse/zephyr/soc/realtek/fingerprint/Kconfig.soc"
osource "/Users/michaelibrahim/Documents/cse/550/cse550/finalproject/edge_impulse/zephyr/soc/realtek/ec/Kconfig.soc"
osource "/Users/michaelibrahim/Documents/cse/550/cse550/finalproject/edge_impulse/zephyr/soc/realtek/bee/Kconfig.soc"
osource "/Users/michaelibrahim/Documents/cse/550/cse550/finalproject/edge_impulse/zephyr/soc/realtek/ameba/Kconfig.soc"
osource "/Users/michaelibrahim/Documents/cse/550/cse550/finalproject/edge_impulse/zephyr/soc/raspberrypi/rpi_pico/Kconfig.soc"
osource "/Users/michaelibrahim/Documents/cse/550/cse550/finalproject/edge_impulse/zephyr/soc/quicklogic/eos_s3/Kconfig.soc"
osource "/Users/michaelibrahim/Documents/cse/550/cse550/finalproject/edge_impulse/zephyr/soc/qemu/virt_riscv/Kconfig.soc"
osource "/Users/michaelibrahim/Documents/cse/550/cse550/finalproject/edge_impulse/zephyr/soc/qemu/or1k/Kconfig.soc"
osource "/Users/michaelibrahim/Documents/cse/550/cse550/finalproject/edge_impulse/zephyr/soc/qemu/malta/Kconfig.soc"
osource "/Users/michaelibrahim/Documents/cse/550/cse550/finalproject/edge_impulse/zephyr/soc/openisa/rv32m1/Kconfig.soc"
osource "/Users/michaelibrahim/Documents/cse/550/cse550/finalproject/edge_impulse/zephyr/soc/openhwgroup/cva6/Kconfig.soc"
osource "/Users/michaelibrahim/Documents/cse/550/cse550/finalproject/edge_impulse/zephyr/soc/oct/osd32mp15x/Kconfig.soc"
osource "/Users/michaelibrahim/Documents/cse/550/cse550/finalproject/edge_impulse/zephyr/soc/nxp/s32/Kconfig.soc"
osource "/Users/michaelibrahim/Documents/cse/550/cse550/finalproject/edge_impulse/zephyr/soc/nxp/rw/Kconfig.soc"
osource "/Users/michaelibrahim/Documents/cse/550/cse550/finalproject/edge_impulse/zephyr/soc/nxp/mcx/Kconfig.soc"
osource "/Users/michaelibrahim/Documents/cse/550/cse550/finalproject/edge_impulse/zephyr/soc/nxp/lpc/Kconfig.soc"
osource "/Users/michaelibrahim/Documents/cse/550/cse550/finalproject/edge_impulse/zephyr/soc/nxp/layerscape/Kconfig.soc"
osource "/Users/michaelibrahim/Documents/cse/550/cse550/finalproject/edge_impulse/zephyr/soc/nxp/kinetis/Kconfig.soc"
osource "/Users/michaelibrahim/Documents/cse/550/cse550/finalproject/edge_impulse/zephyr/soc/nxp/imxrt/Kconfig.soc"
osource "/Users/michaelibrahim/Documents/cse/550/cse550/finalproject/edge_impulse/zephyr/soc/nxp/imx/Kconfig.soc"
osource "/Users/michaelibrahim/Documents/cse/550/cse550/finalproject/edge_impulse/zephyr/soc/nuvoton/numicro/Kconfig.soc"
osource "/Users/michaelibrahim/Documents/cse/550/cse550/finalproject/edge_impulse/zephyr/soc/nuvoton/numaker/Kconfig.soc"
osource "/Users/michaelibrahim/Documents/cse/550/cse550/finalproject/edge_impulse/zephyr/soc/nuvoton/npcx/Kconfig.soc"
osource "/Users/michaelibrahim/Documents/cse/550/cse550/finalproject/edge_impulse/zephyr/soc/nuvoton/npcm/Kconfig.soc"
osource "/Users/michaelibrahim/Documents/cse/550/cse550/finalproject/edge_impulse/zephyr/soc/nordic/Kconfig.soc"
osource "/Users/michaelibrahim/Documents/cse/550/cse550/finalproject/edge_impulse/zephyr/soc/neorv32/Kconfig.soc"
osource "/Users/michaelibrahim/Documents/cse/550/cse550/finalproject/edge_impulse/zephyr/soc/native/inf_clock/Kconfig.soc"
osource "/Users/michaelibrahim/Documents/cse/550/cse550/finalproject/edge_impulse/zephyr/soc/microchip/sam/sama7/Kconfig.soc"
osource "/Users/michaelibrahim/Documents/cse/550/cse550/finalproject/edge_impulse/zephyr/soc/microchip/sam/sam_d5x_e5x/Kconfig.soc"
osource "/Users/michaelibrahim/Documents/cse/550/cse550/finalproject/edge_impulse/zephyr/soc/microchip/pic64/Kconfig.soc"
osource "/Users/michaelibrahim/Documents/cse/550/cse550/finalproject/edge_impulse/zephyr/soc/microchip/pic32c/pic32cz_ca/Kconfig.soc"
osource "/Users/michaelibrahim/Documents/cse/550/cse550/finalproject/edge_impulse/zephyr/soc/microchip/pic32c/pic32cx_sg/Kconfig.soc"
osource "/Users/michaelibrahim/Documents/cse/550/cse550/finalproject/edge_impulse/zephyr/soc/microchip/pic32c/pic32cm_sg_gc/Kconfig.soc"
osource "/Users/michaelibrahim/Documents/cse/550/cse550/finalproject/edge_impulse/zephyr/soc/microchip/pic32c/pic32cm_pl/Kconfig.soc"
osource "/Users/michaelibrahim/Documents/cse/550/cse550/finalproject/edge_impulse/zephyr/soc/microchip/pic32c/pic32cm_jh/Kconfig.soc"
osource "/Users/michaelibrahim/Documents/cse/550/cse550/finalproject/edge_impulse/zephyr/soc/microchip/pic32c/pic32ck_sg_gc/Kconfig.soc"
osource "/Users/michaelibrahim/Documents/cse/550/cse550/finalproject/edge_impulse/zephyr/soc/microchip/miv/Kconfig.soc"
osource "/Users/michaelibrahim/Documents/cse/550/cse550/finalproject/edge_impulse/zephyr/soc/microchip/mec/Kconfig.soc"
osource "/Users/michaelibrahim/Documents/cse/550/cse550/finalproject/edge_impulse/zephyr/soc/mediatek/mt8xxx/Kconfig.soc"
osource "/Users/michaelibrahim/Documents/cse/550/cse550/finalproject/edge_impulse/zephyr/soc/lowrisc/opentitan/Kconfig.soc"
osource "/Users/michaelibrahim/Documents/cse/550/cse550/finalproject/edge_impulse/zephyr/soc/litex/Kconfig.soc"
osource "/Users/michaelibrahim/Documents/cse/550/cse550/finalproject/edge_impulse/zephyr/soc/ite/ec/Kconfig.soc"
osource "/Users/michaelibrahim/Documents/cse/550/cse550/finalproject/edge_impulse/zephyr/soc/intel/wildcat_lake/Kconfig.soc"
osource "/Users/michaelibrahim/Documents/cse/550/cse550/finalproject/edge_impulse/zephyr/soc/intel/raptor_lake/Kconfig.soc"
osource "/Users/michaelibrahim/Documents/cse/550/cse550/finalproject/edge_impulse/zephyr/soc/intel/panther_lake/Kconfig.soc"
osource "/Users/michaelibrahim/Documents/cse/550/cse550/finalproject/edge_impulse/zephyr/soc/intel/lakemont/Kconfig.soc"
osource "/Users/michaelibrahim/Documents/cse/550/cse550/finalproject/edge_impulse/zephyr/soc/intel/intel_socfpga_std/Kconfig.soc"
osource "/Users/michaelibrahim/Documents/cse/550/cse550/finalproject/edge_impulse/zephyr/soc/intel/intel_socfpga/Kconfig.soc"
osource "/Users/michaelibrahim/Documents/cse/550/cse550/finalproject/edge_impulse/zephyr/soc/intel/intel_niosv/Kconfig.soc"
osource "/Users/michaelibrahim/Documents/cse/550/cse550/finalproject/edge_impulse/zephyr/soc/intel/intel_ish/Kconfig.soc"
osource "/Users/michaelibrahim/Documents/cse/550/cse550/finalproject/edge_impulse/zephyr/soc/intel/intel_adsp/Kconfig.soc"
osource "/Users/michaelibrahim/Documents/cse/550/cse550/finalproject/edge_impulse/zephyr/soc/intel/elkhart_lake/Kconfig.soc"
osource "/Users/michaelibrahim/Documents/cse/550/cse550/finalproject/edge_impulse/zephyr/soc/intel/atom/Kconfig.soc"
osource "/Users/michaelibrahim/Documents/cse/550/cse550/finalproject/edge_impulse/zephyr/soc/intel/apollo_lake/Kconfig.soc"
osource "/Users/michaelibrahim/Documents/cse/550/cse550/finalproject/edge_impulse/zephyr/soc/intel/alder_lake/Kconfig.soc"
osource "/Users/michaelibrahim/Documents/cse/550/cse550/finalproject/edge_impulse/zephyr/soc/infineon/psoc4/Kconfig.soc"
osource "/Users/michaelibrahim/Documents/cse/550/cse550/finalproject/edge_impulse/zephyr/soc/infineon/edge/Kconfig.soc"
osource "/Users/michaelibrahim/Documents/cse/550/cse550/finalproject/edge_impulse/zephyr/soc/infineon/cat3/Kconfig.soc"
osource "/Users/michaelibrahim/Documents/cse/550/cse550/finalproject/edge_impulse/zephyr/soc/infineon/cat1c/Kconfig.soc"
osource "/Users/michaelibrahim/Documents/cse/550/cse550/finalproject/edge_impulse/zephyr/soc/infineon/cat1b/Kconfig.soc"
osource "/Users/michaelibrahim/Documents/cse/550/cse550/finalproject/edge_impulse/zephyr/soc/infineon/cat1a/Kconfig.soc"
osource "/Users/michaelibrahim/Documents/cse/550/cse550/finalproject/edge_impulse/zephyr/soc/gd/gd32/Kconfig.soc"
osource "/Users/michaelibrahim/Documents/cse/550/cse550/finalproject/edge_impulse/zephyr/soc/gaisler/leon3/Kconfig.soc"
osource "/Users/michaelibrahim/Documents/cse/550/cse550/finalproject/edge_impulse/zephyr/soc/gaisler/gr716a/Kconfig.soc"
osource "/Users/michaelibrahim/Documents/cse/550/cse550/finalproject/edge_impulse/zephyr/soc/focaltech/Kconfig.soc"
osource "/Users/michaelibrahim/Documents/cse/550/cse550/finalproject/edge_impulse/zephyr/soc/espressif/Kconfig.soc"
osource "/Users/michaelibrahim/Documents/cse/550/cse550/finalproject/edge_impulse/zephyr/soc/ene/kb1200/Kconfig.soc"
osource "/Users/michaelibrahim/Documents/cse/550/cse550/finalproject/edge_impulse/zephyr/soc/ene/kb106x/Kconfig.soc"
osource "/Users/michaelibrahim/Documents/cse/550/cse550/finalproject/edge_impulse/zephyr/soc/elan/em32f967/Kconfig.soc"
osource "/Users/michaelibrahim/Documents/cse/550/cse550/finalproject/edge_impulse/zephyr/soc/egis/Kconfig.soc"
osource "/Users/michaelibrahim/Documents/cse/550/cse550/finalproject/edge_impulse/zephyr/soc/efinix/sapphire/Kconfig.soc"
osource "/Users/michaelibrahim/Documents/cse/550/cse550/finalproject/edge_impulse/zephyr/soc/cdns/xtensa_sample_controller/Kconfig.soc"
osource "/Users/michaelibrahim/Documents/cse/550/cse550/finalproject/edge_impulse/zephyr/soc/cdns/swerv/Kconfig.soc"
osource "/Users/michaelibrahim/Documents/cse/550/cse550/finalproject/edge_impulse/zephyr/soc/cdns/sample_controller32/Kconfig.soc"
osource "/Users/michaelibrahim/Documents/cse/550/cse550/finalproject/edge_impulse/zephyr/soc/cdns/dc233c/Kconfig.soc"
osource "/Users/michaelibrahim/Documents/cse/550/cse550/finalproject/edge_impulse/zephyr/soc/brcm/bcmvk/Kconfig.soc"
osource "/Users/michaelibrahim/Documents/cse/550/cse550/finalproject/edge_impulse/zephyr/soc/brcm/bcm2712/Kconfig.soc"
osource "/Users/michaelibrahim/Documents/cse/550/cse550/finalproject/edge_impulse/zephyr/soc/brcm/bcm2711/Kconfig.soc"
osource "/Users/michaelibrahim/Documents/cse/550/cse550/finalproject/edge_impulse/zephyr/soc/blackberry/qnxhv_vm/Kconfig.soc"
osource "/Users/michaelibrahim/Documents/cse/550/cse550/finalproject/edge_impulse/zephyr/soc/bflb/Kconfig.soc"
osource "/Users/michaelibrahim/Documents/cse/550/cse550/finalproject/edge_impulse/zephyr/soc/atmel/sam0/Kconfig.soc"
osource "/Users/michaelibrahim/Documents/cse/550/cse550/finalproject/edge_impulse/zephyr/soc/atmel/sam/Kconfig.soc"
osource "/Users/michaelibrahim/Documents/cse/550/cse550/finalproject/edge_impulse/zephyr/soc/aspeed/Kconfig.soc"
osource "/Users/michaelibrahim/Documents/cse/550/cse550/finalproject/edge_impulse/zephyr/soc/arm/Kconfig.soc"
osource "/Users/michaelibrahim/Documents/cse/550/cse550/finalproject/edge_impulse/zephyr/soc/arm/beetle/Kconfig.soc"
osource "/Users/michaelibrahim/Documents/cse/550/cse550/finalproject/edge_impulse/zephyr/soc/antmicro/myra/Kconfig.soc"
osource "/Users/michaelibrahim/Documents/cse/550/cse550/finalproject/edge_impulse/zephyr/soc/andestech/Kconfig.soc"
osource "/Users/michaelibrahim/Documents/cse/550/cse550/finalproject/edge_impulse/zephyr/soc/amd/acp_7_x/Kconfig.soc"
osource "/Users/michaelibrahim/Documents/cse/550/cse550/finalproject/edge_impulse/zephyr/soc/amd/acp_7_0/Kconfig.soc"
osource "/Users/michaelibrahim/Documents/cse/550/cse550/finalproject/edge_impulse/zephyr/soc/amd/acp_6_0/Kconfig.soc"
osource "/Users/michaelibrahim/Documents/cse/550/cse550/finalproject/edge_impulse/zephyr/soc/ambiq/Kconfig.soc"
osource "/Users/michaelibrahim/Documents/cse/550/cse550/finalproject/edge_impulse/zephyr/soc/allwinner/sun8i_h3/Kconfig.soc"
osource "/Users/michaelibrahim/Documents/cse/550/cse550/finalproject/edge_impulse/zephyr/soc/allwinner/sun50i_h618/Kconfig.soc"
osource "/Users/michaelibrahim/Documents/cse/550/cse550/finalproject/edge_impulse/zephyr/soc/alif/ensemble/Kconfig.soc"
osource "/Users/michaelibrahim/Documents/cse/550/cse550/finalproject/edge_impulse/zephyr/soc/alif/balletto/Kconfig.soc"
osource "/Users/michaelibrahim/Documents/cse/550/cse550/finalproject/edge_impulse/zephyr/soc/aesc/Kconfig.soc"
osource "/Users/michaelibrahim/Documents/cse/550/cse550/finalproject/edge_impulse/zephyr/soc/adi/max32/Kconfig.soc"
```
