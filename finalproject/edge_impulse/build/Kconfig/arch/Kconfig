## finalproject/edge_impulse/build/Kconfig/arch/Kconfig
```kconfig
# Load Zephyr Arch Kconfig descriptions.
osource "/Users/michaelibrahim/Documents/cse/550/cse550/finalproject/edge_impulse/zephyr/arch/rx/Kconfig"
osource "/Users/michaelibrahim/Documents/cse/550/cse550/finalproject/edge_impulse/zephyr/arch/x86/Kconfig"
osource "/Users/michaelibrahim/Documents/cse/550/cse550/finalproject/edge_impulse/zephyr/arch/xtensa/Kconfig"
osource "/Users/michaelibrahim/Documents/cse/550/cse550/finalproject/edge_impulse/zephyr/arch/sparc/Kconfig"
osource "/Users/michaelibrahim/Documents/cse/550/cse550/finalproject/edge_impulse/zephyr/arch/riscv/Kconfig"
osource "/Users/michaelibrahim/Documents/cse/550/cse550/finalproject/edge_impulse/zephyr/arch/posix/Kconfig"
osource "/Users/michaelibrahim/Documents/cse/550/cse550/finalproject/edge_impulse/zephyr/arch/openrisc/Kconfig"
osource "/Users/michaelibrahim/Documents/cse/550/cse550/finalproject/edge_impulse/zephyr/arch/mips/Kconfig"
osource "/Users/michaelibrahim/Documents/cse/550/cse550/finalproject/edge_impulse/zephyr/arch/arm64/Kconfig"
osource "/Users/michaelibrahim/Documents/cse/550/cse550/finalproject/edge_impulse/zephyr/arch/arm/Kconfig"
osource "/Users/michaelibrahim/Documents/cse/550/cse550/finalproject/edge_impulse/zephyr/arch/arc/Kconfig"
```

## finalproject/edge_impulse/build/Kconfig/boards/Kconfig
```kconfig
# Load Zephyr board Kconfig descriptions.
osource "/Users/michaelibrahim/Documents/cse/550/cse550/finalproject/edge_impulse/zephyr/boards/nordic/nrf5340dk/Kconfig"
```

## finalproject/edge_impulse/build/Kconfig/boards/Kconfig.defconfig
```kconfig
# Load Zephyr board defconfig descriptions.
osource "/Users/michaelibrahim/Documents/cse/550/cse550/finalproject/edge_impulse/zephyr/boards/nordic/nrf5340dk/Kconfig.defconfig"
```
